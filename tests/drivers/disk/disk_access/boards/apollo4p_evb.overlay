/*
 * Copyright (c) 2025 Apollo4P EVB
 * SPDX-License-Identifier: Apache-2.0
 *
 * Use zephyr,sdmmc-disk child node under &sdio0 so that the test's
 * disk_access API targets the SD/MMC disk attached to QEMU's -drive if=sd.
 */

&sdio0 {
	mmc {
		compatible = "zephyr,sdmmc-disk";
		disk-name = "SD";
		status = "okay";
	};
};
