## drivers/audio/Kconfig.es8311
```kconfig
# Copyright (c) 2026 Process Mission
# SPDX-License-Identifier: Apache-2.0

config AUDIO_CODEC_ES8311
	bool "Everest ES8311 driver"
	default y
	select I2C
	depends on GPIO
	depends on DT_HAS_EVEREST_ES8311_ENABLED
	help
	  Enable the driver for the Everest Semiconductor ES8311 low power
	  mono audio codec with ADC and DAC.
```

## dts/bindings/audio/everest,es8311.yaml
```yaml
# Copyright (c) 2026 Process Mission
# SPDX-License-Identifier: Apache-2.0

description: Everest Semiconductor ES8311 low power mono audio codec

include: [i2c-device.yaml]

compatible: "everest,es8311"

properties:
  pa-gpios:
    type: phandle-array
    description: |
      Power amplifier enable pin, driven active while the codec is
      started and inactive while it is suspended.
```

## samples/drivers/i2s/echo/Kconfig
```kconfig
# Copyright (c) 2021 Nordic Semiconductor ASA
# Copyright (c) 2025 Croxel Inc.
# SPDX-License-Identifier: Apache-2.0

source "Kconfig.zephyr"

config I2C
	default $(dt_compat_on_bus,$(DT_COMPAT_WOLFSON_WM8731),i2c) \
		|| $(dt_compat_on_bus,$(DT_COMPAT_ADI_MAX9867),i2c)

config TOGGLE_ECHO_EFFECT_SW0
	bool "Toggle echo effect when pressing sw0"
	depends on $(dt_alias_enabled,sw0)
	select GPIO
	default y

config STOP_START_STREAMS_SW1
	bool "Start/stop I2S streams when pressing sw1"
	depends on $(dt_alias_enabled,sw1)
	select GPIO
	default y

config I2S_MCLK_FREQUENCY
	int "MCLK frequency in Hz"
	default 11289600
	help
	  Master clock frequency for the codec.  Defaults to
	  256 * 44100 Hz (standard for 44.1 kHz with 256× MCLK
	  ratio, used by ES8311 and similar codecs).

config APP_OUTPUT_VOLUME
	int "Output volume percentage (0-100)"
	default 50
	help
	  Volume level for the audio codec output.

config APP_INPUT_GAIN_DB
	int "Microphone gain in dB"
	default 6
	help
	  Microphone PGA gain for the audio codec input.
```

## samples/drivers/i2s/echo/boards/esp32p4_wifi6_dev_kit_esp32p4_hpcore.conf
```kconfig
CONFIG_I2S=y
CONFIG_AUDIO=y
CONFIG_AUDIO_CODEC=y
CONFIG_I2S_ESP32_TX_BLOCK_COUNT=8
CONFIG_I2S_ESP32_RX_BLOCK_COUNT=8
CONFIG_LOG=y

# Buttons not available on this board
CONFIG_TOGGLE_ECHO_EFFECT_SW0=n
CONFIG_STOP_START_STREAMS_SW1=n

# MCLK = 256 * 44100
CONFIG_I2S_MCLK_FREQUENCY=11289600
CONFIG_I2C=y
CONFIG_APP_OUTPUT_VOLUME=50
CONFIG_APP_INPUT_GAIN_DB=6
```
