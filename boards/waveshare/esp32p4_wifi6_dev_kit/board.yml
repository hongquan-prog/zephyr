## boards/waveshare/esp32p4_wifi6_dev_kit/board.yml
```yaml
board:
  name: esp32p4_wifi6_dev_kit
  full_name: Waveshare ESP32-P4-WIFI6-Dev-Kit
  vendor: waveshare
  socs:
  - name: esp32p4
```

## tests/drivers/disk/disk_access/boards/apollo4p_evb.conf
```kconfig
# Copyright (c) 2025 Apollo4P EVB
# SPDX-License-Identifier: Apache-2.0

# Immediate logging is required on this QEMU target: without it the
# wall-time overhead of log output is missing and the Apollo4P stimer
# compare logic spins in QEMU.
CONFIG_LOG=y
CONFIG_LOG_MODE_IMMEDIATE=y

# The async SDIO path calls k_sem_give() from ISR before the kernel is
# ready, leading to a "k_current_get called pre-kernel" panic in this test.
CONFIG_AMBIQ_SDIO_ASYNC=n

# The Ambiq SDIO/SDHC stack needs more room than the test defaults.
CONFIG_MAIN_STACK_SIZE=4096
CONFIG_IDLE_STACK_SIZE=512
CONFIG_ZTEST_STACK_SIZE=4096
```
